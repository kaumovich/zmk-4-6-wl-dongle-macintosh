## config/west.yml
```yaml
manifest:
  remotes:    
    - name: aroum
      url-base: https://github.com/aroum
    - name: badjeff
      url-base: https://github.com/badjeff

  projects:
  projects:
    - name: zmk
      remote: aroum
      revision: main
      import: app/west.yml

    - name: zmk-pmw3610-driver
      remote: badjeff
      revision: 77635ba

  self:
    path: config
```
